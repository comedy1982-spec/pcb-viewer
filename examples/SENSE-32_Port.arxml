AUTOSAR XML (schema 4.0)
package /EcucConfig
  module config Port
    PortConfigSet ()
      PortContainer_0 ()
        11 x PortPin:
          PortPin_LED_STATUS: PortPinId=15, PortPinDirection=PORT_PIN_OUT, PortPinMode=PORT_PIN_MODE_DIO, PortPinLevelValue=PORT_PIN_LEVEL_HIGH
          PortPin_FLASH_CS: PortPinId=2, PortPinDirection=PORT_PIN_OUT, PortPinMode=PORT_PIN_MODE_DIO, PortPinLevelValue=PORT_PIN_LEVEL_HIGH
          PortPin_SPI1_SCK: PortPinId=5, PortPinDirection=PORT_PIN_OUT, PortPinMode=PORT_PIN_MODE_SPI
          PortPin_SPI1_MISO: PortPinId=3, PortPinDirection=PORT_PIN_IN, PortPinMode=PORT_PIN_MODE_SPI
          PortPin_SPI1_MOSI: PortPinId=4, PortPinDirection=PORT_PIN_OUT, PortPinMode=PORT_PIN_MODE_SPI
          PortPin_I2C1_SCL: PortPinId=18, PortPinDirection=PORT_PIN_INOUT, PortPinMode=PORT_PIN_MODE_I2C
          PortPin_I2C1_SDA: PortPinId=20, PortPinDirection=PORT_PIN_INOUT, PortPinMode=PORT_PIN_MODE_I2C
          PortPin_USB_DP: PortPinId=10, PortPinDirection=PORT_PIN_INOUT, PortPinMode=PORT_PIN_MODE_USB
          PortPin_USB_DM: PortPinId=9, PortPinDirection=PORT_PIN_INOUT, PortPinMode=PORT_PIN_MODE_USB
          PortPin_VBUS_MON: PortPinId=26, PortPinDirection=PORT_PIN_IN, PortPinMode=PORT_PIN_MODE_ADC
          PortPin_UART_TX: PortPinId=22, PortPinDirection=PORT_PIN_OUT, PortPinMode=PORT_PIN_MODE_UART
